## conf/layer.conf
```bitbake
BBPATH .= ":${LAYERDIR}"

BBFILES += "${LAYERDIR}/recipes*/*/*.bb ${LAYERDIR}/recipes*/*/*.bbappend"

BBFILE_COLLECTIONS += "meta-auto-os"
BBFILE_PATTERN_meta-auto-os := "^${LAYERDIR}/"

BBFILE_PRIORITY_meta-auto-os = "7"

LAYERDEPENDS_meta-auto-os = "meta-edgeai"

LAYERSERIES_COMPAT_meta-auto-os = "kirkstone"

KERNEL_DEVICETREE_PREFIX:append:j721s2 = " ti/k3-v3link"
KERNEL_DEVICETREE_PREFIX:append:j784s4 = " ti/k3-v3link"
KERNEL_DEVICETREE_PREFIX:append:j722s = " \
    ti/k3-fpdlink \
    ti/k3-v3link \
"

PREFERRED_VERSION_python3-numpy = "1.23.%"
```

## wic/sk-tda4vm-32gb-partition-table.wks
```
# Bootloader partition
part /boot --source bootimg-partition --ondisk mmcblk0 --fstype=vfat --label BOOT --active --align 1024 --fixed-size 128M --use-uuid

# First instnce partition
part / --source rootfs --ondisk mmcblk0 --fstype=ext4 --label instance_A --align 1024 --fixed-size 14G --use-uuid

# Second instance partition
part / --source rootfs --ondisk mmcblk0 --fstype=ext4 --label instance_B --align 1024 --fixed-size 14G --use-uuid

# Reserved space
part /data --ondisk mmcblk0 --fstype=ext4 --label DATA --align 1024 --fixed-size 512M --use-uuid
```
